## buildroot/package/atari800-netsio/Config.in
```kconfig
config BR2_PACKAGE_ATARI800_NETSIO
    bool "atari800-netsio"
    select BR2_PACKAGE_LIBPNG
    select BR2_PACKAGE_SDL
    help
      Atari800 is an emulator for the Atari 8-bit computers and this version adds FujiNet support via netsio

      https://github.com/mozzwald/atari800
```

## buildroot/package/atari800/Config.in
```kconfig
config BR2_PACKAGE_ATARI800
    bool "atari800"
    help
      Atari800 is an emulator for the Atari 8-bit computers.

      https://github.com/atari800/atari800
```

## buildroot/package/fujinet-pc/Config.in
```kconfig
config BR2_PACKAGE_FUJINET_PC
	bool "fujinet-pc (FujiNet host utility)"
    select BR2_PACKAGE_EXPAT
    select BR2_PACKAGE_MBEDTLS
	help
	  Pulls the FujiNet firmware tree and prepares to build the
	  native “fujinet-pc” host executable.
```

## buildroot/package/libretro-common/Config.in
```kconfig
config BR2_PACKAGE_LIBRETRO_COMMON
    bool "libretro-common"
    help
      Reusable coding blocks useful for libretro core and frontend
      development, written primarily in C. Provides shared headers and
      source files required by all libretro cores. Permissively licensed.
```
